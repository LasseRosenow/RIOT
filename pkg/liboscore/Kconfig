## pkg/liboscore/Kconfig
```kconfig
# Copyright (c) 2021 HAW Hamburg
#
# This file is subject to the terms and conditions of the GNU Lesser
# General Public License v2.1. See the file LICENSE in the top level
# directory for more details.
#

menuconfig PACKAGE_LIBOSCORE
    bool "LibOSCORE package"
    depends on TEST_KCONFIG
    help
        OSCORE package

if PACKAGE_LIBOSCORE

endif # PACKAGE_LIBOSCORE
```

## sys/registry/Kconfig
```kconfig
# Copyright (c) 2023 HAW Hamburg
#
# This file is subject to the terms and conditions of the GNU Lesser
# General Public License v2.1. See the file LICENSE in the top level
# directory for more details.
#

menuconfig MODULE_REGISTRY
    bool "REGISTRY"
    help
        RIOT Registry module for handling runtime configurations.

if MODULE_REGISTRY

config REGISTRY_ENABLE_META_NAME
    bool "Include name string in schemas"

config REGISTRY_ENABLE_META_DESCRIPTION
    bool "Include description string in schemas"

config REGISTRY_ENABLE_ALLOWED_VALUES_CHECK
    bool "Check if new values are allowed"

config REGISTRY_ENABLE_FORBIDDEN_VALUES_CHECK
    bool "Check if new values are forbidden"

config REGISTRY_ENABLE_MIN_VALUE_CHECK
    bool "Check if new value does not exceed minimum"

config REGISTRY_ENABLE_MAX_VALUE_CHECK
    bool "Check if new value does not exceed maximum"

config REGISTRY_USE_UINT64
    bool "Enable 64 bit unsigned integer type"

config REGISTRY_USE_INT64
    bool "Enable 64 bit integer type"

config REGISTRY_USE_FLOAT32
    bool "Enable 32 bit float type"

config REGISTRY_USE_FLOAT64
    bool "Enable 64 bit float type"

config MODULE_REGISTRY_INT_PATH
    bool "Access configuration parameters via an integer path"

config MODULE_REGISTRY_STRING_PATH
    bool "Access configuration parameters via a string path"

rsource "namespace/Kconfig"
rsource "storage/Kconfig"

endif # MODULE_REGISTRY
```

## sys/registry/namespace/Kconfig
```kconfig
# Copyright (c) 2023 HAW Hamburg
#
# This file is subject to the terms and conditions of the GNU Lesser
# General Public License v2.1. See the file LICENSE in the top level
# directory for more details.
#

menuconfig MODULE_REGISTRY_NAMESPACE
    bool "REGISTRY_NAMESPACE"
    depends on MODULE_REGISTRY
    help
        Namespace module containing default namespaces for the RIOT Registry sys module.

if MODULE_REGISTRY_NAMESPACE

rsource "sys/Kconfig"
rsource "tests/Kconfig"

endif # MODULE_REGISTRY_NAMESPACE
```

## sys/registry/namespace/tests/Kconfig
```kconfig
# Copyright (c) 2023 HAW Hamburg
#
# This file is subject to the terms and conditions of the GNU Lesser
# General Public License v2.1. See the file LICENSE in the top level
# directory for more details.
#

menuconfig MODULE_REGISTRY_NAMESPACE_TESTS
    bool "REGISTRY_NAMESPACE_TESTS"
    depends on MODULE_REGISTRY
    help
        Namespace Tests module providing common testing configuration schemas for the RIOT Registry sys module.

if MODULE_REGISTRY_NAMESPACE_TESTS

config MODULE_REGISTRY_NAMESPACE_TESTS_FULL
    bool "Full schema"

endif # MODULE_REGISTRY_NAMESPACE_TESTS
```

## sys/registry/namespace_sys/Kconfig
```kconfig
# Copyright (c) 2023 HAW Hamburg
#
# This file is subject to the terms and conditions of the GNU Lesser
# General Public License v2.1. See the file LICENSE in the top level
# directory for more details.
#

menuconfig MODULE_REGISTRY_NAMESPACE_SYS
    bool "REGISTRY_NAMESPACE_SYS"
    depends on MODULE_REGISTRY
    help
        Namespace Sys module providing common sys configuration schemas for the RIOT Registry sys module.

if MODULE_REGISTRY_NAMESPACE_SYS

config MODULE_REGISTRY_NAMESPACE_SYS_RGB_LED
    bool "RGB LED schema"

endif # MODULE_REGISTRY_NAMESPACE_SYS
```

## sys/registry/storage/Kconfig
```kconfig
# Copyright (c) 2023 HAW Hamburg
#
# This file is subject to the terms and conditions of the GNU Lesser
# General Public License v2.1. See the file LICENSE in the top level
# directory for more details.
#

menuconfig MODULE_REGISTRY_STORAGE
    bool "MODULE_REGISTRY_STORAGE"
    depends on MODULE_REGISTRY
    help
        Storage module allowing to store configuration parameters to non-volatile storage.

if MODULE_REGISTRY_STORAGE

config MODULE_REGISTRY_STORAGE_HEAP
    bool "Heap storage"

endif # MODULE_REGISTRY_STORAGE
```
